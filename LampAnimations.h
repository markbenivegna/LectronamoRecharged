#ifndef LAMP_ANIMATIONS_H

#include "RPU_Config.h"
#include "RPU.h"

// Lamp animation arrays — 8 bytes per frame = lamps 0-63
// Byte 0: lamps  0- 7  (BONUS_1K through BONUS_8K)
// Byte 1: lamps  8-15  (BONUS_9K=b0, BONUS_10K=b1, ADV_BONUS_1=b4, ..4=b7)
// Byte 2: lamps 16-23  (unused)
// Byte 3: lamps 24-31  (XTRA_BALL=b0, SPINNER=b4, SAUCER=b5)
// Byte 4: lamps 32-39  (5BANK_SPEC=b0, ROLLOVER=b1, LEFT_RETURN=b2, DROP_5X=b3,
//                        MULT_2X=b4, MULT_3X=b5, MULT_5X=b6, EXTRA_BALL_LANE=b7)
// Byte 5: lamps 40-47  (SHOOT_AGAIN=b0, MATCH=b1, DROP_2X=b2, DROP_3X=b3)
// Byte 6: lamps 48-55  (head: BALL_IN_PLAY, HIGH_SCORE, GAME_OVER, TILT, PLAYER 1-4)
// Byte 7: lamps 56-63  (head: PLAYER_UP 1-4)

#define NUM_LAMP_ANIMATIONS       4
#define LAMP_ANIMATION_STEPS      24
#define NUM_LAMP_ANIMATION_BYTES  8

// The Classic Flow attract sequence is rendered programmatically
// (ShowClassicFlowAttract in the main sketch), not from this table.
byte LampAnimations[NUM_LAMP_ANIMATIONS][LAMP_ANIMATION_STEPS][NUM_LAMP_ANIMATION_BYTES] = {
  // Radar Sweep Arms (idx 0) — generated by PinballRefresh.com Animation Generator (corrected for Q24/Q25 swap)
  {
    {0x03, 0x00, 0x00, 0x00, 0xD5, 0x0C, 0x00, 0x00},
    {0x07, 0x00, 0x00, 0x00, 0x9E, 0x08, 0x00, 0x00},
    {0x0C, 0x00, 0x00, 0x00, 0x0E, 0x00, 0x00, 0x00},
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    {0x01, 0x10, 0x00, 0x00, 0xF1, 0x05, 0x00, 0x00}
  },
  // Side to Side (Ping Pong) (idx 1) — generated by PinballRefresh.com Animation Generator (corrected for Q24/Q25 swap)
  {
    {0x00, 0x03, 0x00, 0x00, 0x04, 0x00, 0x00, 0x00},
    {0xE0, 0x03, 0x00, 0x00, 0x04, 0x00, 0x00, 0x00},
    {0xFE, 0x03, 0x00, 0x00, 0x95, 0x00, 0x00, 0x00},
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    {0x00, 0x03, 0x00, 0x00, 0x04, 0x00, 0x00, 0x00}
  },
  // Center Out (idx 2) — generated by PinballRefresh.com Animation Generator (corrected for Q24/Q25 swap)
  {
    {0x00, 0x00, 0x00, 0x00, 0x00, 0x00, 0x00, 0x00},
    {0x00, 0x00, 0x00, 0x00, 0x00, 0x00, 0x00, 0x00},
    {0x00, 0x10, 0x00, 0x00, 0x00, 0x00, 0x00, 0x00},
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    {0x00, 0x00, 0x00, 0x00, 0x02, 0x00, 0x00, 0x00}
  },
  // Radar Sweep (idx 3) — generated by PinballRefresh.com Animation Generator (corrected for Q24/Q25 swap)
  {
    {0x00, 0x00, 0x00, 0x00, 0x00, 0x0C, 0x00, 0x00},
    {0x00, 0x00, 0x00, 0x00, 0x08, 0x08, 0x00, 0x00},
    {0x00, 0x00, 0x00, 0x00, 0x00, 0x00, 0x00, 0x00},
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    {0x00, 0x10, 0x00, 0x00, 0x00, 0x04, 0x00, 0x00}
  }
};


void ShowLampAnimation(byte animationNum, unsigned long divisor, unsigned long baseTime, byte subOffset, boolean dim, boolean reverse = false, byte keepLampOn = 99) {
  if (animationNum >= NUM_LAMP_ANIMATIONS) return;

  byte currentStep = (baseTime / divisor) % LAMP_ANIMATION_STEPS;
  if (reverse) currentStep = (LAMP_ANIMATION_STEPS - 1) - currentStep;

  byte curBitmask;
  byte *currentLampOffsetByte = LampAnimations[animationNum][(currentStep + subOffset) % LAMP_ANIMATION_STEPS];
  byte *currentLampByte = LampAnimations[animationNum][currentStep];

  byte lampNum = 0;
  for (int byteNum = 0; byteNum < NUM_LAMP_ANIMATION_BYTES; byteNum++) {
    curBitmask = 0x01;
    for (byte bitNum = 0; bitNum < 8; bitNum++) {
      byte lampOn = (*currentLampByte) & curBitmask;
      if (subOffset) {
        byte lampOff = (*currentLampOffsetByte) & curBitmask;
        if (lampOff && lampNum != keepLampOn && !lampOn) RPU_SetLampState(lampNum, 0);
      }
      if (lampOn) RPU_SetLampState(lampNum, 1, dim);
      curBitmask *= 2;
      lampNum += 1;
    }
    currentLampByte += 1;
    currentLampOffsetByte += 1;
  }
}


void ShowLampAnimationSingleStep(byte animationNum, byte currentStep, byte *lampsToAvoid = NULL) {
  if (animationNum >= NUM_LAMP_ANIMATIONS) return;

  byte lampNum = 0;
  byte *currentLampByte = LampAnimations[animationNum][currentStep];
  byte *currentAvoidByte = lampsToAvoid;
  byte curBitmask;

  for (int byteNum = 0; byteNum < NUM_LAMP_ANIMATION_BYTES; byteNum++) {
    curBitmask = 0x01;
    for (byte bitNum = 0; bitNum < 8; bitNum++) {
      boolean avoidLamp = false;
      if (currentAvoidByte != NULL) {
        if ((*currentAvoidByte) & curBitmask) avoidLamp = true;
      }
      if (!avoidLamp) RPU_SetLampState(lampNum, (*currentLampByte) & curBitmask);
      lampNum += 1;
      curBitmask *= 2;
    }
    currentLampByte += 1;
    if (currentAvoidByte != NULL) currentAvoidByte += 1;
  }
}


boolean FetchAnimationBytes(byte *destinationArray, byte animationNum, byte frameNum) {
  if (destinationArray == NULL) return false;
  if (animationNum >= NUM_LAMP_ANIMATIONS || frameNum >= LAMP_ANIMATION_STEPS) return false;
  memcpy(destinationArray, LampAnimations[animationNum][frameNum], NUM_LAMP_ANIMATION_BYTES);
  return true;
}


// Classic Flow attract sequence - the gameplay tutorial, played twice per pass.
// One tutorial = the original 1978 attract bonus story followed by an Arc Surge
// combo demo. Rendered programmatically from elapsed time rather than from the
// animation table above.
// Bonus story (timed from original-ROM attract footage):
//   1) Climb: the bonus ladder steps 1K->10K (800ms per step) while the four
//      advance-bonus bolt lamps chase upward (200ms each, one full chase per
//      ladder step) - spinner hits feeding the bonus.
//   2) Reaching 10K lights the spinner sign; the chase freezes on the red (4th)
//      lamp at the top of the bolt next to the sign.
//   3) Collect: the ladder walks back down to 1K at 400ms per step.
//   4) 1K holds, then the bonus multiplier arch (2X/3X/5X) lights together.
// Arc Surge demo (the combo path in succession, using live-gameplay visuals):
//   5) Trigger: the right return lane (extra ball) lamp pulses.
//   6) Window running: the fast 50ms ladder chase, as in a live Arc Surge.
//   7) The shots to hit: T1/saucer lamp pulses while the chase continues.
//   8) Completed: all bonus lamps strobe with the saucer solid - the same
//      celebration the game plays for landing the combo. Trigger lamp goes out.
// The rollover button and drop-target 2X lamps are on during the bonus story
// only; the Arc Surge demo lights just the combo-related lamps.
#define CLASSIC_FLOW_BONUS_STORY_MS 14200UL
#define CLASSIC_FLOW_ARC_DEMO_MS    7400UL
#define CLASSIC_FLOW_TUTORIAL_MS (CLASSIC_FLOW_BONUS_STORY_MS + CLASSIC_FLOW_ARC_DEMO_MS)
#define CLASSIC_FLOW_LOOPS          2
#define CLASSIC_FLOW_CYCLE_MS (CLASSIC_FLOW_LOOPS * CLASSIC_FLOW_TUTORIAL_MS)
void ShowClassicFlowAttract(unsigned long t) {
  // The tutorial plays CLASSIC_FLOW_LOOPS times per pass
  t = (t % CLASSIC_FLOW_CYCLE_MS) % CLASSIC_FLOW_TUTORIAL_MS;

  if (t >= CLASSIC_FLOW_BONUS_STORY_MS) {
    // Arc Surge combo demo - only combo-related lamps are lit
    unsigned long d = t - CLASSIC_FLOW_BONUS_STORY_MS;
    RPU_SetLampState(LAMP_ROLLOVER_BUTTON, 0);
    RPU_SetLampState(LAMP_DROP_TARGET_2X, 0);
    RPU_SetLampState(LAMP_SPINNER, 0);
    for (byte i = 0; i < 4; i++) RPU_SetLampState(LAMP_ADVANCE_BONUS_1 + i, 0);
    RPU_SetLampState(LAMP_BONUS_MULTIPLIER_2X, 0);
    RPU_SetLampState(LAMP_BONUS_MULTIPLIER_3X, 0);
    RPU_SetLampState(LAMP_BONUS_MULTIPLIER_5X, 0);
    if (d < 1600) {
      // Trigger: right return lane lamp pulses
      RPU_SetLampState(LAMP_XTRA_BALL, (byte)((d / 200) % 2));
      for (byte i = 0; i < 10; i++) RPU_SetLampState(LAMP_BONUS_1K + i, 0);
      RPU_SetLampState(LAMP_SAUCER, 0);
    } else if (d < 3600) {
      // Window running: fast chase up the ladder
      RPU_SetLampState(LAMP_XTRA_BALL, 1);
      byte chasePhase = (byte)((d / 50) % 10);
      for (byte i = 0; i < 10; i++) RPU_SetLampState(LAMP_BONUS_1K + i, i == chasePhase);
      RPU_SetLampState(LAMP_SAUCER, 0);
    } else if (d < 5600) {
      // The shots to hit: T1/saucer pulses, chase continues
      RPU_SetLampState(LAMP_XTRA_BALL, 1);
      byte chasePhase = (byte)((d / 50) % 10);
      for (byte i = 0; i < 10; i++) RPU_SetLampState(LAMP_BONUS_1K + i, i == chasePhase);
      RPU_SetLampState(LAMP_SAUCER, 1, 0, 200);
    } else {
      // Completed: bonus lamps strobe, saucer solid, trigger lamp out
      RPU_SetLampState(LAMP_XTRA_BALL, 0);
      byte flashOn = (byte)((d / 75) % 2);
      for (byte i = 0; i < 10; i++) RPU_SetLampState(LAMP_BONUS_1K + i, flashOn);
      RPU_SetLampState(LAMP_SAUCER, 1);
    }
    return;
  }

  RPU_SetLampState(LAMP_ROLLOVER_BUTTON, 1);
  RPU_SetLampState(LAMP_DROP_TARGET_2X, 1);
  RPU_SetLampState(LAMP_SAUCER, 0);
  RPU_SetLampState(LAMP_XTRA_BALL, 0);

  byte ladderLamp;        // 0-9 = LAMP_BONUS_1K .. LAMP_BONUS_10K
  byte chaseLamp;         // 0-3 = LAMP_ADVANCE_BONUS_1 .. _4
  boolean spinnerOn = false;
  boolean archOn = false;

  if (t < 8000) {
    // Climb 1K through 10K with the bolt chase running bottom-to-top
    ladderLamp = (byte)(t / 800);
    chaseLamp = (byte)((t % 800) / 200);
    if (ladderLamp == 9) spinnerOn = true;
  } else if (t < 11600) {
    // Collect: walk down 9K through 1K, chase held on the red lamp
    ladderLamp = 8 - (byte)((t - 8000) / 400);
    chaseLamp = 3;
    spinnerOn = true;
  } else {
    // Hold 1K, then light the multiplier arch
    ladderLamp = 0;
    chaseLamp = 3;
    spinnerOn = true;
    if (t >= 12000) archOn = true;
  }

  for (byte i = 0; i < 10; i++) RPU_SetLampState(LAMP_BONUS_1K + i, i == ladderLamp);
  for (byte i = 0; i < 4; i++) RPU_SetLampState(LAMP_ADVANCE_BONUS_1 + i, i == chaseLamp);
  RPU_SetLampState(LAMP_SPINNER, spinnerOn);
  RPU_SetLampState(LAMP_BONUS_MULTIPLIER_2X, archOn);
  RPU_SetLampState(LAMP_BONUS_MULTIPLIER_3X, archOn);
  RPU_SetLampState(LAMP_BONUS_MULTIPLIER_5X, archOn);
}


#define LAMP_ANIMATIONS_H
#endif
